/* Copyright (c) 2014, The Linux Foundation. All rights reserved.
 *
 * This program is free software; you can redistribute it and/or modify
 * it under the terms of the GNU General Public License version 2 and
 * only version 2 as published by the Free Software Foundation.
 *
 * This program is distributed in the hope that it will be useful,
 * but WITHOUT ANY WARRANTY; without even the implied warranty of
 * MERCHANTABILITY or FITNESS FOR A PARTICULAR PURPOSE.  See the
 * GNU General Public License for more details.
 */

&mdss_mdp {
	dsi_sony_tone: qcom,mdss_dsi_panel {
		mdss_dsi_synaptics_lgd_1080p_cmd {
			qcom,mdss-dsi-panel-name = "Synaptics LGD command mode dsi panel";
			qcom,mdss-dsi-panel-type = "dsi_cmd_mode";
			qcom,mdss-dsi-panel-width = <1080>;
			qcom,mdss-dsi-panel-height = <1920>;
			qcom,mdss-dsi-bpp = <24>;
			qcom,mdss-dsi-h-back-porch = <8>;
			qcom,mdss-dsi-h-pulse-width = <8>;
			qcom,mdss-dsi-h-front-porch = <56>;
			qcom,mdss-dsi-v-back-porch = <8>;
			qcom,mdss-dsi-v-pulse-width = <8>;
			qcom,mdss-dsi-v-front-porch = <227>;
			qcom,mdss-pan-physical-width-dimension = <61>;
			qcom,mdss-pan-physical-height-dimension = <110>;
			qcom,mdss-dsi-panel-framerate = <60>;
			qcom,mdss-dsi-virtual-channel-id = <0>;
			qcom,mdss-dsi-stream = <0>;
			qcom,mdss-dsi-h-sync-skew = <0>;
			qcom,mdss-dsi-h-left-border = <0>;
			qcom,mdss-dsi-h-right-border = <0>;
			qcom,mdss-dsi-v-top-border = <0>;
			qcom,mdss-dsi-v-bottom-border = <0>;
			qcom,mdss-dsi-underflow-color = <0x0>;
			qcom,mdss-dsi-border-color = <0>;
			qcom,mdss-dsi-h-sync-pulse = <1>;
			qcom,mdss-dsi-traffic-mode = "non_burst_sync_event";
			qcom,mdss-dsi-bllp-eof-power-mode;
			qcom,mdss-dsi-bllp-power-mode;
			qcom,mdss-dsi-dma-trigger = "trigger_sw";
			qcom,mdss-dsi-mdp-trigger = "none";
			qcom,mdss-dsi-tx-eot-append;
			qcom,mdss-dsi-on-command = [
					05 01 00 00 64 00 01 11];
			qcom,mdss-dsi-post-panel-on-command = [
					05 01 00 00 00 00 01 29];
			qcom,mdss-dsi-off-command = [
					05 01 00 00 14 00 01 28
					05 01 00 00 64 00 01 10];
			qcom,mdss-dsi-on-command-state = "dsi_lp_mode";
			qcom,mdss-dsi-off-command-state = "dsi_hs_mode";
			qcom,mdss-dsi-te-pin-select = <1>;
			qcom,mdss-dsi-wr-mem-start = <0x2c>;
			qcom,mdss-dsi-wr-mem-continue = <0x3c>;
			qcom,mdss-dsi-te-dcs-command = <1>;
			qcom,mdss-dsi-te-check-enable;
			qcom,mdss-dsi-te-using-te-pin;
			qcom,mdss-dsi-lane-0-state;
			qcom,mdss-dsi-lane-1-state;
			qcom,mdss-dsi-lane-2-state;
			qcom,mdss-dsi-lane-3-state;
			qcom,mdss-dsi-panel-timings = [E6 38 26 00 68 6E 2A 3C 2C 03 04 00];
			qcom,mdss-dsi-t-clk-post = <0x1B>;
			qcom,mdss-dsi-t-clk-pre = <0x2B>;
			qcom,panel-supply-entries = <&dsi_panel_pwr_supply_full_incell>;
			qcom,mdss-dsi-lp11-init;
			qcom,mdss-dsi-bl-min-level = <1>;
			qcom,mdss-dsi-bl-max-level = <4095>;
			qcom,mdss-brightness-max-level = <4095>;
			qcom,mdss-dsi-bl-pmic-control-type = "bl_ctrl_wled";


			qcom,mdss-dsi-panel-timings-8996 = [
					24 1f 08 09 05 03 04 a0
					24 1f 08 09 05 03 04 a0
					24 1f 08 09 05 03 04 a0
					24 1f 08 09 05 03 04 a0
					24 1b 08 09 05 03 04 a0];

			qcom,mdss-lcd-id-adc = <215000 256000>;
		};
	};
};
