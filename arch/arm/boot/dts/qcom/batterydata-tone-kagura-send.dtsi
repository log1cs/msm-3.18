/* Copyright (c) 2015, The Linux Foundation. All rights reserved.
 *
 * This program is free software; you can redistribute it and/or modify
 * it under the terms of the GNU General Public License version 2 and
 * only version 2 as published by the Free Software Foundation.
 *
 * This program is distributed in the hope that it will be useful,
 * but WITHOUT ANY WARRANTY; without even the implied warranty of
 * MERCHANTABILITY or FITNESS FOR A PARTICULAR PURPOSE.  See the
 * GNU General Public License for more details.
 */

qcom,tone-kagura-send {
	qcom,batt-id-kohm = <330>;
	qcom,battery-type = "1302-1082";
	qcom,chg-rslow-comp-c1 = <2554773>;
	qcom,chg-rslow-comp-c2 = <3207629>;
	qcom,chg-rs-to-rslow = <1011368>;
	qcom,chg-rslow-comp-thr = <0x9A>;
	qcom,fg-profile-data = [
		 E7 83 A8 7C
		 78 80 12 76
		 32 83 4E 71
		 37 6C D9 6D
		 FF 81 76 99
		 05 BC 3B C8
		 58 0F E5 83
		 01 7C C1 7B
		 D4 74 2E 83
		 7D 78 CC 7E
		 34 72 18 82
		 13 9A 5D BD
		 E6 CA 62 0E
		 4C 0B 6C 5A
		 88 6D 78 FC
		 51 32 F0 45
		 FE 3A 00 00
		 A4 45 6E 3B
		 FE 22 00 00
		 00 00 00 00
		 00 00 00 00
		 1E 71 52 70
		 57 77 3A 7B
		 4D 7C 2B 70
		 8E 74 9E 7A
		 07 7C 7E 6B
		 5B 6E 98 A9
		 20 73 5A 33
		 4E A0 71 0C
		 28 00 FF 36
		 F0 11 30 03
		 00 00 00 0C
	];
};
