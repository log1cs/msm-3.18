/* 2017-02-17: File added and changed by Sony Corporation */
/*
 * dts for openq820 APQ8096 v3 + PMI8996
 *
 * Copyright 2017 Sony Corporation
 *
 * Original code is apq8096-v3-pmi8996-dragonboard.dts
 */
/* Copyright (c) 2015, The Linux Foundation. All rights reserved.
 *
 * This program is free software; you can redistribute it and/or modify
 * it under the terms of the GNU General Public License version 2 and
 * only version 2 as published by the Free Software Foundation.
 *
 * This program is distributed in the hope that it will be useful,
 * but WITHOUT ANY WARRANTY; without even the implied warranty of
 * MERCHANTABILITY or FITNESS FOR A PARTICULAR PURPOSE.  See the
 * GNU General Public License for more details.
 */


/dts-v1/;

#include "apq8096-v3.dtsi"
#include "msm-pmi8996.dtsi"
#include "apq8096-openq820.dtsi"

/ {
	model = "Qualcomm Technologies, Inc. APQ8096v3 + PMI8996 OpenQ820";
	compatible = "qcom,apq8096-dragonboard", "qcom,msm8996",
			"qcom,apq8096", "qcom,dragonboard";
	qcom,msm-id = <246 0x30000>, <291 0x30000>,
			<246 0x30001>, <291 0x30001>;
	qcom,board-id = <10 0>;
};

&soc {
	qcom,rmnet-ipa {
		status = "okay";
	};
};

&ipa_hw {
	status = "okay";
};
