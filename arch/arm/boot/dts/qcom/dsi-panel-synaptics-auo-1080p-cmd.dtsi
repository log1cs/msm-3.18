/* Copyright (c) 2014, The Linux Foundation. All rights reserved.
 *
 * This program is free software; you can redistribute it and/or modify
 * it under the terms of the GNU General Public License version 2 and
 * only version 2 as published by the Free Software Foundation.
 *
 * This program is distributed in the hope that it will be useful,
 * but WITHOUT ANY WARRANTY; without even the implied warranty of
 * MERCHANTABILITY or FITNESS FOR A PARTICULAR PURPOSE.  See the
 * GNU General Public License for more details.
 */

&mdss_mdp {
	dsi_sony_tone: qcom,mdss_dsi_panel {
		mdss_dsi_synaptics_auo_1080p_cmd {
			qcom,mdss-dsi-panel-name = "Synaptics AUO command mode dsi panel";
			qcom,mdss-dsi-panel-type = "dsi_cmd_mode";
			qcom,mdss-dsi-panel-width = <1080>;
			qcom,mdss-dsi-panel-height = <1920>;
			qcom,mdss-dsi-bpp = <24>;
			qcom,mdss-dsi-h-back-porch = <8>;
			qcom,mdss-dsi-h-pulse-width = <8>;
			qcom,mdss-dsi-h-front-porch = <56>;
			qcom,mdss-dsi-v-back-porch = <8>;
			qcom,mdss-dsi-v-pulse-width = <8>;
			qcom,mdss-dsi-v-front-porch = <227>;
			qcom,mdss-pan-physical-width-dimension = <61>;
			qcom,mdss-pan-physical-height-dimension = <110>;
			qcom,mdss-dsi-panel-framerate = <60>;
			qcom,mdss-dsi-virtual-channel-id = <0>;
			qcom,mdss-dsi-stream = <0>;
			qcom,mdss-dsi-h-sync-skew = <0>;
			qcom,mdss-dsi-h-left-border = <0>;
			qcom,mdss-dsi-h-right-border = <0>;
			qcom,mdss-dsi-v-top-border = <0>;
			qcom,mdss-dsi-v-bottom-border = <0>;
			qcom,mdss-dsi-underflow-color = <0x00>;
			qcom,mdss-dsi-border-color = <0>;
			qcom,mdss-dsi-h-sync-pulse = <1>;
			qcom,mdss-dsi-traffic-mode = "non_burst_sync_event";
			qcom,mdss-dsi-bllp-eof-power-mode;
			qcom,mdss-dsi-bllp-power-mode;
			qcom,mdss-dsi-dma-trigger = "trigger_sw";
			qcom,mdss-dsi-mdp-trigger = "none";
			qcom,mdss-dsi-tx-eot-append;
			qcom,mdss-dsi-on-command = [
				29 01 00 00 00 00 02 B0 04
				29 01 00 00 00 00 06 B3 04 10 00 00 00
				29 01 00 00 00 00 03 B4 0C 00
				29 01 00 00 00 00 04 B6 3B D3 00
				29 01 00 00 00 00 07 B8 00 78 64 10 64 B4
				29 01 00 00 00 00 07 B9 00 78 64 10 64 B4
				29 01 00 00 00 00 07 BA 00 78 64 10 64 B4
				29 01 00 00 00 00 04 BB 00 B4 A0
				29 01 00 00 00 00 04 BC 00 B4 A0
				29 01 00 00 00 00 04 BD 00 B4 A0
				29 01 00 00 00 00 02 C0 00
				29 01 00 00 00 00 20 C1 84 00 00 FF 47 19 25 30 67 AD CF 9A 73 8D FD B5 8E 79 62 88 F1 3F 00 00 40 00 82 03 08 00 01
				29 01 00 00 00 00 0B C2 01 F7 80 04 63 00 60 00 01 30
				29 01 00 00 00 00 07 C3 55 01 00 01 00 00
				29 01 00 00 00 00 12 C4 70 00 00 00 00 00 00 00 00 02 01 00 03 01 00 00 00
				29 01 00 00 00 00 0F C6 51 02 51 05 4D 01 0E 01 02 01 02 07 12 07
				29 01 00 00 00 00 1F C7 00 14 1E 29 37 44 4D 59 3B 43 4F 5D 66 6E 76 00 14 1E 29 37 44 4D 59 3B 43 4F 5D 66 6E 76
				29 01 00 00 00 00 14 C8 00 00 00 00 00 FC 00 00 00 00 00 FC 00 00 00 00 00 FC 00
				29 01 00 00 00 00 09 C9 2A 60 2A 60 90 90 C4 00
				29 01 00 00 00 00 21 CA 00 80 80 80 80 80 80 80 08 20 80 80 0A 4A 37 A0 55 F8 0C 0C 20 10 3F 3F 00 00 10 10 3F 3F 3F 3F
				29 01 00 00 00 00 0A CB FC F7 FB 0F 0C 02 10 0C 00
				29 01 00 00 00 00 02 CC 05
				29 01 00 00 00 00 19 CE 5D 40 43 49 55 62 71 82 94 A8 B9 CB DB E9 F5 FC FF 04 00 04 04 00 00 00
				29 01 00 00 00 00 11 D0 19 01 91 0B D4 19 14 00 00 00 19 99 00 00 00 00
				29 01 00 00 00 00 1D D3 1B 3B BB AD A5 33 33 33 00 80 A1 AA 4B 4B 33 33 33 F7 F2 1F 7D 7C FF 0F 99 00 FF FF
				29 01 00 00 00 00 04 D4 57 33 01
				29 01 00 00 00 00 0C D5 66 00 00 01 30 01 30 00 1B 00 1B
				29 01 00 00 00 00 21 D7 04 FF 23 55 47 1E FE 78 F0 19 A8 0F 38 3E 60 1C 0F 8F C7 E3 99 E1 30 00 00 00 00 F0 EB 39 18 07
				29 01 00 00 00 00 06 DE 00 00 3F FF 10
				29 01 00 00 00 00 02 E7 0F
				15 01 00 00 00 00 02 35 00
				05 01 00 00 00 00 01 29];
			qcom,mdss-dsi-post-panel-on-command = [
					05 01 00 00 78 00 01 11];
			qcom,mdss-dsi-off-command = [
				05 01 00 00 00 00 01 28
				05 01 00 00 78 00 01 10];
			qcom,mdss-dsi-on-command-state = "dsi_lp_mode";
			qcom,mdss-dsi-off-command-state = "dsi_hs_mode";
			qcom,mdss-dsi-te-pin-select = <1>;
			qcom,mdss-dsi-wr-mem-start = <0x2c>;
			qcom,mdss-dsi-wr-mem-continue = <0x3c>;
			qcom,mdss-dsi-te-dcs-command = <1>;
			qcom,mdss-dsi-te-check-enable;
			qcom,mdss-dsi-te-using-te-pin;
			qcom,mdss-dsi-lane-0-state;
			qcom,mdss-dsi-lane-1-state;
			qcom,mdss-dsi-lane-2-state;
			qcom,mdss-dsi-lane-3-state;
			qcom,mdss-dsi-panel-timings = [E6 38 26 00 68 6E 2A 3C 2C 03 04 00];
			qcom,mdss-dsi-t-clk-post = <0x1B>;
			qcom,mdss-dsi-t-clk-pre = <0x2B>;
			qcom,mdss-dsi-lp11-init;
			qcom,mdss-dsi-bl-pmic-control-type = "bl_ctrl_wled";
			qcom,mdss-dsi-bl-pmic-pwm-frequency = <50>;
			qcom,mdss-dsi-bl-pmic-bank-select = <2>;
			qcom,mdss-dsi-reset-sequence = <1 2>, <0 5>, <1 120>;
			qcom,mdss-dsi-min-refresh-rate = <53>;
			qcom,mdss-dsi-max-refresh-rate = <60>;
			qcom,mdss-dsi-pan-enable-dynamic-fps;
			qcom,mdss-dsi-pan-fps-update = "dfps_immediate_porch_mode_vfp";
			qcom,mdss-dsi-panel-status-check-mode = "bta_check";
			qcom,esd-check-enabled;
			qcom,mdss-brightness-max-level = <4095>;
			qcom,mdss-dsi-panel-timings-8996 = [
				24 1f 08 09 05 03 04 a0
				24 1f 08 09 05 03 04 a0
				24 1f 08 09 05 03 04 a0
				24 1f 08 09 05 03 04 a0
				24 1b 08 09 05 03 04 a0];
			qcom,mdss-lcd-id-adc = <1087000 1231000>;
		};
	};
};
